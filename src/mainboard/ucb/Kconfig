## src/mainboard/ucb/Kconfig
```kconfig
if VENDOR_UCB

choice
        prompt "Mainboard model"

source "src/mainboard/ucb/*/Kconfig.name"

endchoice

source "src/mainboard/ucb/*/Kconfig"

config MAINBOARD_VENDOR
        string "Mainboard Vendor"
        default "UCB"

endif
```

## src/mainboard/ucb/lx9/Kconfig
```kconfig
if BOARD_UCB_LX9

config BOARD_SPECIFIC_OPTIONS
        def_bool y
        select ARCH_BOOTBLOCK_RISCV
        select BOARD_ID_AUTO
        select BOARD_ROMSIZE_KB_16384
        select COMMON_CBFS_SPI_WRAPPER
        select HAVE_HARD_RESET
        select RAM_CODE_SUPPORT
        select SOC_UCB_ZSCALE
        select SPI_FLASH
        select SPI_FLASH_STMICRO

config MAINBOARD_DIR
        string
        default ucb/spartan6

config MAINBOARD_PART_NUMBER
        string
        default "LX9"

config MAINBOARD_VENDOR
        string
        default "UCB"

endif
```
